## arch/arm/hotplug/Kconfig
```kconfig
config CLUSTER_PLUG
	tristate "Cluster-Plug hotplug driver for homogeneous ARM big.LITTLE systems"
        default n
        help
          CPU hotplug driver designed for ARM big.LITTLE systems where
          both the big and little CPUs are of the same type. On these
          systems, it preferable to normall use the big cluster, and
          only activate the little cluster for highly parallel loads.
          This hotplug implementation always keeps the big cluster
          online, and only activates the little cluster for heavy
          parallel loads.

config ALUCARD_HOTPLUG
	bool "Enable alucard-hotplug cpu hotplug driver"
	default n
	help
	  Generic Alucard-hotplug cpu hotplug driver for ARM SOCs

config THUNDERPLUG_CONTROL
	tristate "Thunderplug - plugging down/up of multi-cores using powersuspend"
        default n
 	    help
 	       This driver uses powersuspend to take down the cpu cores on a octa core device.

config BRICKED_HOTPLUG
	bool "Enable kernel based mpdecision"
	depends on MSM_RUN_QUEUE_STATS
	default n
	help
	 This enables kernel based multi core control.
	 (up/down hotplug based on load)
	 
config INTELLI_PLUG
	   bool "Hotplug for Razor Reborn"
	   depends on MSM_RUN_QUEUE_STATS
	   default n
	   help
		 This enables kernel based multi core control. Best Choice for Razor Reborn
		 
config MSM_HOTPLUG
	   config MSM_HOTPLUG
	bool "MSM hotplug driver"
	depends on HOTPLUG_CPU
	default n
	help
	  The MSM hotplug driver controls on-/offlining of additional cores based
	  on current cpu load.
	  
config MSM_SLEEPER
    bool "CPU hotplug driver"
 	default n
 	help
	  CPU hotplug driver
	  
config STATE_HELPER
        tristate "State Helper"
        default n
	depends on STATE_NOTIFIER
 	    help
 	       This driver hotplugs cores based on battery level (Quadcore)
```
